/* ============================================================
 * @file linker.ld
 * @brief Turbox 内核链接脚本
 *
 * 层级：
 *   TurboBoxOS/
 *
 * 项目内绝对路径：
 *   TurboBoxOS/linker.ld
 *
 * 模块作用：
 *   定义内核二进制 layout。loader 把内核读盘加载到物理
 *   0x10000，链接基址必须与之对齐，否则保护模式跳转后
 *   所有符号地址错位。
 *
 * 使用者：
 *   tools/build.py 调用 i686-elf-ld 时使用本脚本。
 *
 * 项目角色：
 *   tools 层链接配置，把各模块目标文件组织成可启动的
 *   平坦二进制 turbox.bin。
 *
 * 引入说明：
 *   不依赖其他脚本或模块。
 *
 * 维护记录：
 *   2026-08-30 初始创建
 * ============================================================ */

/* 直接产出平坦二进制，供 boot 扇区读盘 */
OUTPUT_FORMAT("binary")

/* 入口符号，与 boot/loader.asm 的 extern 引用一致 */
ENTRY(kernel_main)

SECTIONS
{
    /* 链接基址 = loader 加载地址，二者必须一致 */
    . = 0x10000;

    .text : {
        /* 代码段放最前，kernel_main 落在 0x10000 附近 */
        *(.text)
        /* 只读数据紧跟代码，减少段间空洞 */
        *(.rodata*)
    }

    .data : {
        *(.data)
    }

    .bss : {
        /* 未初始化数据；平坦二进制不占空间，由加载方清零 */
        *(.bss)
        *(COMMON)
    }
}